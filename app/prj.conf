## CMakeLists.txt
```
cmake_minimum_required(VERSION 3.20.0)

list(APPEND ZEPHYR_EXTRA_MODULES ${CMAKE_CURRENT_SOURCE_DIR}/../modules/say_hello)



find_package(Zephyr REQUIRED HINTS $ENV{ZEPHYR_BASE})
project(app)

target_sources(app PRIVATE src/main.c)
```

## sample.yaml
```
sample:
  description: A simple application that demonstrates
    basic sanity of the kernel.
  name: Synchronization Sample
tests:
  sample.kernel.synchronization:
    tags: synchronization
    build_on_all: true
    harness: console
    harness_config:
      type: multi_line
      regex:
        - "thread_a: Hello World from (.*)!"
        - "thread_b: Hello World from (.*)!"
```

## prj.conf
```kconfig
CONFIG_STDOUT_CONSOLE=y
# enable to use thread names
CONFIG_THREAD_NAME=y
CONFIG_SCHED_CPU_MASK=y

#Know issue fix
CONFIG_PICOLIBC=n
CONFIG_NEWLIB_LIBC=y


# Enable random generator

CONFIG_STACK_POINTER_RANDOM=0
CONFIG_TEST_RANDOM_GENERATOR=y
CONFIG_TIMER_RANDOM_GENERATOR=y

# Enable the user defined module
CONFIG_SAY_HELLO=y
```

## src/main.c
```c
#include <zephyr/random/random.h>
#include "say_hello.h"
// Settings
static const int32_t sleep_time_ms = 1000;

int main(void)
{
    uint32_t rnd;
    double rnd_float;

    // Do forever
    while (1) 
	{

        // Print random number
        rnd = sys_rand32_get();
		printk("Random number: %u\r\n", rnd);
		say_hello();
        // Sleep
        k_msleep(sleep_time_ms);
    }

    return 0;
}
```
